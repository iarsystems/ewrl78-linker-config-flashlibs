// Specific: R5F10Rx8
define symbol _FLASH_END    = 0x01FFF;
define symbol _RAM_START    = 0xFFB00;
define symbol _DATAFLASH_SZ = 2K;
export symbol _DATAFLASH_SZ;

// Maximum number of variables for EEPROM Emulation Layer Libraries
define symbol _T02_EEL_NUM_VARS = 64;  // [1~64]

// Flash Libraries Self RAM  (referenced in r20ut2944ej0305_rl78.pdf)
define symbol _T01_FSL_SZ   = 0x380;
define symbol _T01_FDL_SZ   = 0x0;
define symbol _T02_FDL_SZ   = 0x0;
define symbol _T02_EEL_SZ   = (0x100 + (2 * _T02_EEL_NUM_VARS));
define symbol _T04_FDL_SZ   = 0x0;

include "common.icf";