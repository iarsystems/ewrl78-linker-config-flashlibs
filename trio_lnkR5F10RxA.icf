// Specific: R5F10RxA
define symbol _FLASH_END    = 0x03FFF;
define symbol _RAM_START    = 0xFFB00;
define symbol _DATAFLASH_SZ = 2k;
export symbol _DATAFLASH_SZ;

// Maximum number of variables for EEPROM Emulation Layer Libraries
define symbol _T02_EEL_NUM_VARS = 64;  // [1~64]

// Flash Libraries Self RAM  (referenced in r20ut2944ej0301_rl78.pdf)
define symbol _T01_FSL_SZ   = 0x180;
define symbol _T01_FDL_SZ   = 0x0;
define symbol _T02_FDL_SZ   = 0x0;
define symbol _T02_EEL_SZ   = (0x100 + (2 * _T02_EEL_NUM_VARS));
define symbol _T04_FDL_SZ   = 0x0;

include "common.icf";