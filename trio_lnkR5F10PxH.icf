// Specific: R5F10PxH (x = G,L,M,P)
define symbol _FLASH_END    = 0x2FFFF;
define symbol _RAM_START    = 0xFBF00;
define symbol _DATAFLASH_SZ = 8K;
export symbol _DATAFLASH_SZ;

// Maximum number of variables for EEPROM Emulation Layer Libraries
define symbol _T01_EEL_NUM_VARS = 255; // [1~255]
define symbol _T02_EEL_NUM_VARS = 64;  // [1~64]

// Flash Libraries Self RAM
define symbol _T01_FSL_SZ   = 0x0;
define symbol _T01_FDL_SZ   = 0x0;
define symbol _T01_EEL_SZ   = 0x0;
define symbol _T02_FDL_SZ   = 0x0;
define symbol _T02_EEL_SZ   = 0x0;
define symbol _T04_FDL_SZ   = 0x0;

include "common.icf";