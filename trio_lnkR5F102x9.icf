// Specific: R5F102x9
define symbol _FLASH_END    = 0x03FFF;
define symbol _RAM_START    = 0xFFB00;
define symbol _DATAFLASH_SZ = 2k;
export symbol _DATAFLASH_SZ;

// Flash Libraries Self RAM
define symbol _T01_FSL_SZ   = 0x380;
define symbol _T01_FDL_SZ   = 0x0;
define symbol _T01_EEL_SZ   = 0x0;
define symbol _T02_FDL_SZ   = 0x0;
define symbol _T02_EEL_SZ   = 0x0;
define symbol _T04_FDL_SZ   = 0x0;

include "common.icf";