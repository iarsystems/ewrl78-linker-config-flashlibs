// Specific: R5F1---TEMPLATE
define symbol _FLASH_END    = 0x[FINAL_FLASH_ADDRESS] ;
define symbol _RAM_START    = 0x[RAM INITIAL ADDRESS] ;
define symbol _DATAFLASH_SZ = [2K,4K,8K] ;
export symbol _DATAFLASH_SZ;

// Maximum number of variables for EEPROM Emulation Layer Libraries
define symbol _T01_EEL_NUM_VARS = 255; // [1~255]
define symbol _T02_EEL_NUM_VARS = 64;  // [1~64]

// Flash Libraries Self RAM  (referenced in r20ut2944ej0305_rl78.pdf)
define symbol _T01_FSL_SZ   = 0x0;
define symbol _T01_FDL_SZ   = 0x0;
define symbol _T01_EEL_SZ   = (0x200 + (2 * _T01_EEL_NUM_VARS));
define symbol _T02_FDL_SZ   = 0x0;
define symbol _T02_EEL_SZ   = (0x100 + (2 * _T02_EEL_NUM_VARS));
define symbol _T04_FDL_SZ   = 0x0;

include "common.icf";
