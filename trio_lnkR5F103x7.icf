// Specific: R5F103x7 (x = 6,7,A)
define symbol _FLASH_END    = 0x00FFF;
define symbol _RAM_START    = 0xFFD00;
define symbol _DATAFLASH_SZ = 0;
export symbol _DATAFLASH_SZ;

// Flash Libraries Self RAM
define symbol _T01_FSL_SZ   = 0x0;
define symbol _T01_FDL_SZ   = 0x0;
define symbol _T02_FDL_SZ   = 0x0;
define symbol _T02_EEL_SZ   = 0x0;
define symbol _T04_FDL_SZ   = 0x0;

include "common.icf";
