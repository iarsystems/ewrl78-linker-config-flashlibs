// Specific: R5F10AxF (x = G,L,M)
define symbol _FLASH_END    = 0x17FFF;
define symbol _RAM_START    = 0xFE700;
define symbol _DATAFLASH_SZ = 4K;
export symbol _DATAFLASH_SZ;

// Maximum number of variables for EEPROM Emulation Layer Libraries
define symbol _T01_EEL_NUM_VARS = 255; // [1~255]
define symbol _T02_EEL_NUM_VARS = 64;  // [1~64]

// Flash Libraries Self RAM
// There is no reservation for Self-RAM on the other RL78 models
define symbol _T01_FSL_SZ   = 0x0;
define symbol _T01_FDL_SZ   = 0x0;
define symbol _T01_EEL_SZ   = 0x0;
define symbol _T02_FDL_SZ   = 0x0;
define symbol _T02_EEL_SZ   = 0x0;
define symbol _T04_FDL_SZ   = 0x0;

include "common.icf";