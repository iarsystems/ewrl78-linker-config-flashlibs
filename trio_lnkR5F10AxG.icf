// Specific: R5F10AxG (x = G,L,M)
define symbol _FLASH_END    = 0x1FFFF;
define symbol _RAM_START    = 0xFDF00;
define symbol _DATAFLASH_SZ = 4K;
export symbol _DATAFLASH_SZ;

// Maximum number of variables for EEPROM Emulation Layer Libraries
define symbol _T01_EEL_NUM_VARS = 255; // [1~255]
define symbol _T02_EEL_NUM_VARS = 64;  // [1~64]

// Flash Libraries Self RAM
// There is no reservation for Self-RAM on the other RL78 models
define symbol _T01_FSL_SZ   = 0x400;
define symbol _T01_FDL_SZ   = 0xC0;
define symbol _T01_EEL_SZ   = (0x200 + (2 * _T01_EEL_NUM_VARS));
define symbol _T02_FDL_SZ   = 0xA0;
define symbol _T02_EEL_SZ   = (0x100 + (2 * _T02_EEL_NUM_VARS));
define symbol _T04_FDL_SZ   = 0x88;

include "common.icf";